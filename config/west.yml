## config/west.yml
```yaml
manifest:
  remotes:
    - name: timception
      url-base: https://github.com/timception
      
  projects:
    - name: zmk
      remote: timception
      revision: v0.3.0
      import: app/west.yml
    - name: zmk-pmw3610-driver-badjeff
      remote: timception
      revision: main
  self:
    path: config
```
